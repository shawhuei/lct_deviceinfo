## slt_devinfo/kernel-3.18/drivers/dev_info/Kconfig
```kconfig
config SLT_DRV_DEVINFO_SUPPORT
        bool "support devinfo drivers By Longcheer"
        default y
        help
         Devoloped by Longcheer,to provide service for showing BSP devices info.
         The engineer can easily record device information.
        # states. If unsure say N.
```
